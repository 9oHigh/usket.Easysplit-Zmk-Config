## config/boards/shields/easysplit_1key/Kconfig.defconfig
```kconfig
if SHIELD_EASYSPLIT_1KEY

config ZMK_KEYBOARD_NAME
    default "EasySplit 1Key"

endif
```

## config/boards/shields/easysplit_1key/Kconfig.shield
```kconfig
config SHIELD_EASYSPLIT_1KEY
    def_bool $(shields_list_contains,easysplit_1key)
```

## config/boards/shields/easysplit_4key/Kconfig.defconfig
```kconfig
if SHIELD_EASYSPLIT_4KEY

config ZMK_KEYBOARD_NAME
    default "EasySplit 4Key"

endif
```

## config/boards/shields/easysplit_4key/Kconfig.shield
```kconfig
config SHIELD_EASYSPLIT_4KEY
    def_bool $(shields_list_contains,easysplit_4key)
```

## config/boards/shields/easysplit_split_2x2/Kconfig.defconfig
```kconfig
if SHIELD_EASYSPLIT_SPLIT_2X2_LEFT

config ZMK_KEYBOARD_NAME
    default "EasySplit 2x2"

config ZMK_SPLIT_ROLE_CENTRAL
    default y

endif

if SHIELD_EASYSPLIT_SPLIT_2X2_LEFT || SHIELD_EASYSPLIT_SPLIT_2X2_RIGHT

config ZMK_SPLIT
    default y

endif
```

## config/boards/shields/easysplit_split_2x2/Kconfig.shield
```kconfig
config SHIELD_EASYSPLIT_SPLIT_2X2_LEFT
    def_bool $(shields_list_contains,easysplit_split_2x2_left)

config SHIELD_EASYSPLIT_SPLIT_2X2_RIGHT
    def_bool $(shields_list_contains,easysplit_split_2x2_right)
```
